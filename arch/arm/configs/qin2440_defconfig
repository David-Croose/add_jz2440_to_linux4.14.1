## arch/arm/configs/qin2440_defconfig
```kconfig
CONFIG_SYSVIPC=y
CONFIG_LOG_BUF_SHIFT=14
CONFIG_BLK_DEV_INITRD=y
CONFIG_INITRAMFS_SOURCE="/root/Work/jz2440/buildroot-2018.08.2/output/images/rootfs.cpio"
CONFIG_ARCH_QIN2440=y
CONFIG_AEABI=y
CONFIG_OABI_COMPAT=y
CONFIG_SERIAL_QIN2440_POLL=y
CONFIG_SERIAL_QIN2440_CONSOLE=y
# CONFIG_HWMON is not set
# CONFIG_RC_CORE is not set
# CONFIG_HID is not set
# CONFIG_USB_SUPPORT is not set
CONFIG_TMPFS=y
# CONFIG_MISC_FILESYSTEMS is not set
```

## arch/arm/mach-qin2440/Kconfig
```kconfig
if ARCH_QIN2440

menu "QIN2440 Configuration"

config QIN_PRINTF
	bool "the debug function: qin_printf()"
	default n
	select DEBUG_KERNEL
	select DEBUG_LL
	help
	  Use the qin_printf() to debug

endmenu

endif
```
